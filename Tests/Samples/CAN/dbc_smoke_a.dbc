VERSION ""

NS_ :

BS_:

BU_: Vector__XXX

BO_ 272 SMOKE_A_MSG: 8 Vector__XXX
 SG_ SMOKE_A_U8 : 0|8@1+ (1,0) [0|255] "" Vector__XXX
 SG_ SMOKE_A_S8 : 8|8@1- (0.5,-10) [-10|117.5] "V" Vector__XXX

VAL_ SMOKE_A_MSG SMOKE_A_U8 0 "Zero" 1 "One" 2 "Two" 255 "Max" ;
