VERSION ""

NS_ :

BS_:

BU_: Vector__XXX

BO_ 256 SMOKE_STD: 8 Vector__XXX
 SG_ SMOKE_U8 : 0|8@1+ (1,0) [0|255] "" Vector__XXX
 SG_ SMOKE_S8 : 8|8@1- (0.5,-10) [-10|117.5] "V" Vector__XXX

BO_ 2147483904 SMOKE_EXT: 8 Vector__XXX
 SG_ SMOKE_LE12 : 0|12@1+ (0.1,0) [0|409.5] "rpm" Vector__XXX
 SG_ SMOKE_BE8 : 23|8@0+ (1,0) [0|255] "" Vector__XXX

VAL_ SMOKE_STD SMOKE_U8 0 "Zero" 1 "One" 2 "Two" 255 "Max" ;
