VERSION ""

NS_ :

BS_:

BU_: Vector__XXX

BO_ 2147483905 SMOKE_B_MSG: 8 Vector__XXX
 SG_ SMOKE_B_LE12 : 0|12@1+ (0.1,0) [0|409.5] "rpm" Vector__XXX
 SG_ SMOKE_B_BE8 : 23|8@0+ (1,0) [0|255] "" Vector__XXX
